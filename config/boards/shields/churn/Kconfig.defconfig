## config/boards/shields/churn/Kconfig.defconfig
```kconfig
# Copyright (c) 2020 The ZMK Contributors
# SPDX-License-Identifier: MIT

if SHIELD_CHURN

config ZMK_KEYBOARD_NAME
    default "Churn"

endif
```
